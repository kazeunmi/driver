// ssd1306-overlay.dts

/dts-v1/;
/plugin/;

/ {
  compatible = "brcm,bcm2835";

  fragment@0 {
    target = <&i2c1>;

    __overlay__ {
      #address-cells = <1>;
      #size-cells = <0>;

      ssd1306: oled@3c {
	compatible = "solomon,ssd1306fb-i2c";
	reg = <0x3c>;
      };
    };
  };
};
