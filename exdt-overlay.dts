// exdt-overlay.dts

/dts-v1/;
/plugin/;

/ {
  compatible = "brcm,bcm2835";

  fragment@0 {
    target = <&i2c1>;

    __overlay__ {
      #address-cells = <1>;
      #size-cells = <0>;

      exdt30: exdt@30 {
	compatible = "ex,exdt";
	reg = <0x30>;
      };
    };
  };
};
